## bootloader/main/Kconfig.projbuild
```kconfig
menu "ESP32-S31 Linux loader"

choice S31_LINUX_BOARD
    prompt "Board"
    default S31_LINUX_BOARD_KORVO1
    help
        The board selects the peripherals that the loader starts before
        Linux.  The Makefile sets it from BOARD.

config S31_LINUX_BOARD_KORVO1
    bool "ESP32-S31-Korvo-1 (LCD, microSD, USB, RGB LED)"

config S31_LINUX_BOARD_ESP32S31
    bool "ESP32-S31-WROOM-3-N16R16V module alone (UART0 only)"

endchoice

config S31_LINUX_START_BT
    bool "Start Bluetooth before the Linux handoff"
    default y
    help
        The esp-emulator S31 model hangs in the BT controller enable
        (BTDM init completes, then the guest spins).  Say n for emulator
        builds; Wi-Fi over ESP-Hosted is unaffected.

config S31_LINUX_LCD_KEEP_ALIVE
    bool "Keep the LCD refresh running after the Linux handoff"
    default y
    help
        The desktop Linux line drives the panel through the frame
        buffer the loader leaves behind, so the LCDC DMA keeps reading
        the reserved (uncached) 0x50f40000 window after the handoff.
        Say n for a headless build (OpenWrt light AP): the loader stops
        the LCDC DMA before starting hart 1, so the kernel may manage
        the whole PSRAM as ordinary cached RAM.  A kernel that writes
        the window cached while the LCDC DMA master keeps streaming it
        wedges the MSPI bus (observed 2026-10-24: reset loop ~0.7 s
        into flash-init, exactly at the first mtdblock0 access).

config S31_LINUX_SD_KERNEL
    bool "Allow IMAGE.BIN on SD to override the flash kernel"
    default y
    depends on S31_LINUX_BOARD_KORVO1
    help
        Desktop Korvo-1 updates boot IMAGE.BIN from FAT p1 first.  Flash-only
        profiles disable this override so an inserted card cannot silently
        boot a different kernel, root filesystem or userspace ABI.

config S31_LINUX_HART1_IRQ_TEST
    bool "Run a bare-metal CLIC timer-interrupt test on hart 1"
    default n
    help
        Diagnostic for esp-emulator bring-up: instead of booting Linux,
        hart 1 programs its machine timer (mtimecmp match -> CLIC input 7,
        M-mode) and prints one character on UART0 per delivered interrupt.
        On hardware this prints a stream of dots; if the emulator never
        delivers the trap, only the start banner appears.

config S31_LINUX_HART1_IRQ_TEST_MTVEC_MODE
    int "mtvec mode bits for the hart 1 interrupt test"
    depends on S31_LINUX_HART1_IRQ_TEST
    default 3
    range 0 3
    help
        3 selects CLIC mode.  0 is what stock OpenSBI writes (direct mode);
        hardware forces CLIC anyway, but an emulator may take it literally.

endmenu
```

## bootloader/sdkconfig.defaults.irqtest
```kconfig
CONFIG_S31_LINUX_START_BT=n
CONFIG_S31_LINUX_HART1_IRQ_TEST=y
CONFIG_S31_LINUX_HART1_IRQ_TEST_MTVEC_MODE=0
```

## br2-external/Config.in
```kconfig
source "$BR2_EXTERNAL_ESP32S31_PATH/package/esp-hosted-linux/Config.in"
source "$BR2_EXTERNAL_ESP32S31_PATH/package/fastfetch/Config.in"
source "$BR2_EXTERNAL_ESP32S31_PATH/package/strace-rv32/Config.in"
source "$BR2_EXTERNAL_ESP32S31_PATH/package/icewm/Config.in"
source "$BR2_EXTERNAL_ESP32S31_PATH/package/dmenu/Config.in"
source "$BR2_EXTERNAL_ESP32S31_PATH/package/xdriver-xf86-video-s31/Config.in"
```

## br2-external/package/dmenu/Config.in
```kconfig
config BR2_PACKAGE_DMENU
	bool "dmenu"
	depends on BR2_PACKAGE_XORG7
	select BR2_PACKAGE_FONTCONFIG
	select BR2_PACKAGE_FREETYPE
	select BR2_PACKAGE_XLIB_LIBX11
	select BR2_PACKAGE_XLIB_LIBXFT
	select BR2_PACKAGE_XLIB_LIBXINERAMA
	select BR2_PACKAGE_XLIB_LIBXRENDER
	help
	  dmenu: suckless dynamic menu launcher for X11.

	  https://tools.suckless.org/dmenu/
```

## br2-external/package/icewm/Config.in
```kconfig
config BR2_PACKAGE_ICEWM
	bool "icewm"
	depends on BR2_INSTALL_LIBSTDCPP
	depends on BR2_PACKAGE_XORG7
	select BR2_PACKAGE_FONTCONFIG
	select BR2_PACKAGE_FREETYPE
	select BR2_PACKAGE_IMLIB2
	select BR2_PACKAGE_XLIB_LIBX11
	select BR2_PACKAGE_XLIB_LIBXEXT
	select BR2_PACKAGE_XLIB_LIBXRENDER
	select BR2_PACKAGE_XLIB_LIBXCOMPOSITE
	select BR2_PACKAGE_XLIB_LIBXCURSOR
	select BR2_PACKAGE_XLIB_LIBXDAMAGE
	select BR2_PACKAGE_XLIB_LIBXFIXES
	select BR2_PACKAGE_XLIB_LIBXFT
	select BR2_PACKAGE_XLIB_LIBXRANDR
	select BR2_PACKAGE_XLIB_LIBSM
	select BR2_PACKAGE_XLIB_LIBICE
	help
	  IceWM window manager: taskbar, start menu, draggable windows.
	  Configured with imlib2 image loading, no NLS/i18n, no sound.

	  https://ice-wm.org/
```

## br2-external/package/xdriver-xf86-video-s31/Config.in
```kconfig
config BR2_PACKAGE_XDRIVER_XF86_VIDEO_S31
	bool "xf86-video-s31"
	depends on BR2_PACKAGE_XSERVER_XORG_SERVER
	depends on BR2_PACKAGE_XDRIVER_XF86_VIDEO_FBDEV
	help
	  Xorg video driver for the ESP32-S31 Korvo-1 framebuffer with
	  EXA hooks into the PPA/DMA2D 2D engines (Solid fill and
	  screen-to-screen Copy).  Falls back to CPU rendering for
	  overlap directions the DMA cannot do safely.

	  Sources: package/xdriver-xf86-video-s31/src (fbdev skeleton
	  plus s31_exa.c on top of the fbaccel register recipes).
```
